## boards/ciaa/edu_ciaa_nxp/board.yml
```yaml
board:
  name: edu_ciaa_nxp
  full_name: EDU-CIAA-NXP
  vendor: ciaa
  socs:
    - name: lpc4337
```

## boards/ciaa/edu_ciaa_nxp/edu_ciaa_nxp_lpc4337_defconfig
```kconfig
CONFIG_SERIAL=y
CONFIG_CONSOLE=y
CONFIG_UART_CONSOLE=y
CONFIG_UART_LPC43XX=y
CONFIG_BUILD_OUTPUT_HEX=y
CONFIG_PINCTRL=y
CONFIG_GPIO=y
```

## dts/bindings/gpio/nxp,lpc43xx-gpio-port.yaml
```yaml
description: Un puerto GPIO del LPC43xx (índice dentro de GPIO_PORT)

compatible: "nxp,lpc43xx-gpio-port"

include:
  - name: gpio-controller.yaml
  - name: base.yaml

properties:
  reg:
    required: true
    description: índice de puerto dentro de los arreglos de GPIO_PORT (0-7)
  "#gpio-cells":
    const: 2
  ngpios:
    type: int
    default: 32

gpio-cells:
  - pin
  - flags
```

## dts/bindings/gpio/nxp,lpc43xx-gpio.yaml
```yaml
description: NXP LPC43xx GPIO_PORT (bloque de registros compartido por los 8 puertos)

compatible: "nxp,lpc43xx-gpio"

include: base.yaml

properties:
  reg:
    required: true
```

## dts/bindings/pinctrl/nxp,lpc43xx-pinctrl.yaml
```yaml
description: NXP LPC43xx System Control Unit (SCU) — multiplexado de pines

compatible: "nxp,lpc43xx-pinctrl"

include: base.yaml

child-binding:
  description: Grupo de pines del LPC43xx
  child-binding:
    description: Nodo de configuración de un pin del LPC43xx.
    properties:
      pinmux:
        required: true
        type: array
        description: |
          Arreglo de valores de configuración de pines codificados con
          LPC43XX_PIN().
```

## dts/bindings/serial/nxp,lpc43xx-uart.yaml
```yaml
description: NXP LPC43xx UART/USART (16550-style IP, not a Flexcomm — the clock is
  a fixed CGU base clock set once at board init, not a per-instance selectable source)

compatible: "nxp,lpc43xx-uart"

include:
  - name: uart-controller.yaml
  - name: pinctrl-device.yaml
  - name: base.yaml

properties:
  reg:
    required: true

  interrupts:
    required: true

  current-speed:
    required: true

  pinctrl-0:
    required: true

  pinctrl-names:
    required: true
```

## soc/nxp/lpc43xx/Kconfig
```kconfig
# Copyright (c) 2026 UTN FRA - Laboratorio de Sistemas Embebidos
# SPDX-License-Identifier: Apache-2.0

config SOC_FAMILY_LPC43XX
	select ARM

config SOC_LPC4337
	select CPU_CORTEX_M4
	select CPU_HAS_ARM_MPU
	select CPU_HAS_FPU
	select CPU_CORTEX_M_HAS_SYSTICK

config UART_LPC43XX
	bool "NXP LPC43xx UART driver"
	default y
	depends on DT_HAS_NXP_LPC43XX_UART_ENABLED
	select SERIAL_HAS_DRIVER
```

## soc/nxp/lpc43xx/Kconfig.defconfig
```kconfig
# Copyright (c) 2026 UTN FRA - Laboratorio de Sistemas Embebidos
# SPDX-License-Identifier: Apache-2.0

if SOC_LPC4337

config NUM_IRQS
	default 53

config SYS_CLOCK_HW_CYCLES_PER_SEC
	default 204000000

endif # SOC_LPC4337
```

## soc/nxp/lpc43xx/Kconfig.soc
```kconfig
# Copyright (c) 2026 UTN FRA - Laboratorio de Sistemas Embebidos
# SPDX-License-Identifier: Apache-2.0

config SOC_FAMILY_LPC43XX
	bool

config SOC_SERIES_LPC433X
	bool
	select SOC_FAMILY_LPC43XX

config SOC_LPC4337
	bool
	select SOC_SERIES_LPC433X
	select SOC_EARLY_INIT_HOOK

config SOC_FAMILY
	default "lpc43xx" if SOC_FAMILY_LPC43XX

config SOC_SERIES
	default "lpc433x" if SOC_SERIES_LPC433X

config SOC
	default "lpc4337" if SOC_LPC4337
```
